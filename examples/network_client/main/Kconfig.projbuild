## examples/network_client/main/Kconfig.projbuild
```kconfig
menu "Example Configuration"

  config EXAMPLE_WIFI_SSID
    string "WiFi SSID"
    default ""

  config EXAMPLE_WIFI_PASSWORD
    string "WiFi password"
    default ""

  config EXAMPLE_SERVER_ADDRESS
    string "Modbus server IP address"
    default "192.168.1.1"

  config EXAMPLE_SERVER_PORT
    int "Modbus server port"
    default "502"    

  endmenu
```

## examples/network_server/main/Kconfig.projbuild
```kconfig
menu "Example Configuration"

  config EXAMPLE_WIFI_SSID
    string "WiFi SSID"
    default ""

  config EXAMPLE_WIFI_PASSWORD
    string "WiFi password"
    default ""

endmenu
```

## examples/uart_client/sdkconfig.defaults
```kconfig
CONFIG_COMPILER_CXX_RTTI=y
CONFIG_LOG_DEFAULT_LEVEL_NONE=y
CONFIG_LOG_DEFAULT_LEVEL=0
CONFIG_LOG_MAXIMUM_LEVEL=0
```

## test/sdkconfig.defaults
```kconfig
CONFIG_COMPILER_CXX_RTTI=y
CONFIG_LOG_DEFAULT_LEVEL_NONE=y
CONFIG_LOG_DEFAULT_LEVEL=0
CONFIG_LOG_MAXIMUM_LEVEL=0
CONFIG_LWIP_SO_RCVBUF=y
CONFIG_ESP32_WIFI_NVS_ENABLED=n
```
